## package/led-project/Config.in
```kconfig
config BR2_PACKAGE_LED_PROJECT
    bool "led-project"
    select BR2_PACKAGE_C_PERIPHERY
    help
      My LED control project built with CMake.

      https://github.com/kryczkal/RaspberryPi4LedLaboratory
```
